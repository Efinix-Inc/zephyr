## west.yml
```yaml
# The west manifest file for upstream Zephyr.
#
# The per-installation west configuration file, .west/config, sets the
# path to the project containing this file in the [manifest] section's
# "path" variable.
#
# You are free to create your own manifest files and put them in any
# repository you want, to create your own custom Zephyr installations.
# For example, you could create a manifest file in your own out of
# tree application directory, which would pull this zephyr repository
# in as an ordinary project.
#
# You can pass your manifest repositories to west init when creating a
# new Zephyr installation. See the west documentation for more
# information.

manifest:
  defaults:
    remote: upstream

  remotes:
    - name: upstream
      url-base: https://github.com/zephyrproject-rtos

  #
  # Please add items below based on alphabetical order
  projects:
    - name: canopennode
      revision: dec12fa3f0d790cafa8414a4c2930ea71ab72ffd
      path: modules/lib/canopennode
    - name: chre
      revision: b7955c27e50485b7dafdc3888d7d6afdc2ac6d96
      path: modules/lib/chre
    - name: cmsis
      revision: 74981bf893e8b10931464b9945e2143d99a3f0a3
      path: modules/hal/cmsis
      groups:
        - hal
    - name: edtt
      revision: 64e5105ad82390164fb73fc654be3f73a608209a
      path: tools/edtt
      groups:
        - tools
    - name: fatfs
      revision: 427159bf95ea49b7680facffaa29ad506b42709b
      path: modules/fs/fatfs
      groups:
        - fs
    - name: libmetal
      revision: efa2ace6028290ddee494a78ade772a0b112ab83
      path: modules/hal/libmetal
      groups:
        - hal
    - name: liblc3
      revision: 448f3de31f49a838988a162ef1e23a89ddf2d2ed
      path: modules/lib/liblc3
    - name: littlefs
      path: modules/fs/littlefs
      groups:
        - fs
      revision: ca583fd297ceb48bced3c2548600dc615d67af24
    - name: loramac-node
      revision: ce57712f3e426bbbb13acaec97b45369f716f43a
      path: modules/lib/loramac-node
    - name: lvgl
      revision: 5ab83099854719ed326b6ecb9b09b07b1eee4818
      path: modules/lib/gui/lvgl
    - name: lz4
      revision: 8e303c264fc21c2116dc612658003a22e933124d
      path: modules/lib/lz4
    - name: mbedtls
      revision: 4e1f66df894dc622da7bcd3884016a6ace08e9ea
      path: modules/crypto/mbedtls
      groups:
        - crypto
    - name: mcuboot
      revision: 59624334748129cb93f096408911a227b0dd64c0
      path: bootloader/mcuboot
    - name: mipi-sys-t
      path: modules/debug/mipi-sys-t
      groups:
        - debug
      revision: 0d521d8055f3b2b4842f728b0365d3f0ece9c37f
    - name: nanopb
      revision: 42fa8b211e946b90b9d968523fce7b1cfe27617e
      path: modules/lib/nanopb
    - name: net-tools
      revision: e0828aa9629b533644dc96ff6d1295c939bd713c
      path: tools/net-tools
      groups:
        - tools
    - name: nrf_hw_models
      revision: 7078310d522664b1612ebac93240b367c4c96299
      path: modules/bsim_hw_models/nrf_hw_models
    - name: open-amp
      revision: aedcc262f93bbb1b0c2f58026911575729b7465c
      path: modules/lib/open-amp
    - name: openthread
      revision: 1f1a826d1891fc99d14822abc0a1de257e9c6e9b
      path: modules/lib/openthread
    - name: picolibc
      path: modules/lib/picolibc
      revision: 0694a78fc08b3300c7db79602c46ba0a64428c8e
    - name: segger
      revision: e2ff2200556e8a8f962921444275c04971a2bb3d
      path: modules/debug/segger
      groups:
        - debug
    - name: sof
      revision: 6f5f7258ad2738df78e600568d38fc261e2a118d
      path: modules/audio/sof
    - name: tflite-micro
      revision: 9156d050927012da87079064db59d07f03b8baf6
      path: modules/lib/tflite-micro
      repo-path: tflite-micro
    - name: tinycrypt
      revision: 3e9a49d2672ec01435ffbf0d788db6d95ef28de0
      path: modules/crypto/tinycrypt
      groups:
        - crypto
    - name: TraceRecorderSource
      revision: d92607521335eaaaedb01b241cdd26fda48a5ca6
      path: modules/debug/TraceRecorder
      groups:
        - debug
    - name: trusted-firmware-m
      revision: 0e25742e8023a0c823c825fbaf19ea265162cc56
      path: modules/tee/tf-m/trusted-firmware-m
      groups:
        - tee
    - name: trusted-firmware-a
      revision: 28f5e137837f1c1a7a7b2af2dd8bb778c0a27532
      path: modules/tee/tf-a/trusted-firmware-a
      groups:
        - tee
    - name: tf-m-tests
      revision: 0f80a65193ddbbe3f0ac38b33b07b26138c11fa7
      path: modules/tee/tf-m/tf-m-tests
      groups:
        - tee
    - name: psa-arch-tests
      revision: 6a17330e0dfb5f319730f974d5b05f7b7f04757b
      path: modules/tee/tf-m/psa-arch-tests
      groups:
        - tee
    - name: uoscore-uedhoc
      revision: e8920192b66db4f909eb9cd3f155d5245c1ae825
      path: modules/lib/uoscore-uedhoc
    - name: zcbor
      revision: 0.6.0
      path: modules/lib/zcbor
    - name: zscilib
      path: modules/lib/zscilib
      revision: 0035be5e6a45e4ab89755b176d305d7a877fc79c
    - name: thrift
      path: modules/lib/thrift
      revision: 10023645a0e6cb7ce23fcd7fd3dbac9f18df6234

  self:
    path: zephyr
    west-commands: scripts/west-commands.yml
    import: submanifests
```
